## Config.in
```kconfig
# Add project-specific packages for Buildroot here
#
# If these are non-proprietary, please consider contributing them back to
# Nerves or Buildroot.

source "$NERVES_DEFCONFIG_DIR/linux/Config.in"

source "$NERVES_DEFCONFIG_DIR/package/openwrt-patches/Config.in"
source "$NERVES_DEFCONFIG_DIR/package/lzma-old/Config.in"
source "$NERVES_DEFCONFIG_DIR/package/swconfig/Config.in"
source "$NERVES_DEFCONFIG_DIR/package/mac80211_nodrv/Config.in"
source "$NERVES_DEFCONFIG_DIR/package/mt76-mt76x8/Config.in"
```

## linux/Config.in
```kconfig
menu "Linux Kernel OpenWrt Extensions"

# openwrt generic
config BR2_LINUX_KERNEL_EXT_OPENWRT_PATCHES
	bool "OpenWrt generic patches"
    select BR2_PACKAGE_OPENWRT_PATCHES
	help
	  Add OpenWrt generic patches

if BR2_LINUX_KERNEL_EXT_OPENWRT_PATCHES
# openwrt ramips
config BR2_LINUX_KERNEL_EXT_OPENWRT_PATCHES_RAMIPS
    bool "OpenWrt ramips patches"
	help
	  Add OpenWrt ramips patches
endif

endmenu
```

## nerves_defconfig
```kconfig
BR2_mipsel=y
BR2_mips_32r2=y

BR2_REPRODUCIBLE=y


BR2_TAR_OPTIONS="--no-same-owner"
BR2_BACKUP_SITE="http://dl.nerves-project.org"
BR2_ENABLE_DEBUG=y
BR2_OPTIMIZE_2=y
BR2_GLOBAL_PATCH_DIR="${BR2_EXTERNAL_NERVES_PATH}/patches"


BR2_TOOLCHAIN_USES_MUSL=y

BR2_TOOLCHAIN_EXTERNAL=y
BR2_TOOLCHAIN_EXTERNAL_CUSTOM=y
BR2_TOOLCHAIN_EXTERNAL_CUSTOM_MUSL=y
BR2_TOOLCHAIN_EXTERNAL_GCC_10=y
BR2_TOOLCHAIN_EXTERNAL_HEADERS_4_19=y
BR2_TOOLCHAIN_EXTERNAL_CUSTOM_PREFIX="mipsel-nerves-linux-musl"
BR2_TOOLCHAIN_EXTERNAL_CXX=y

BR2_TOOLCHAIN_EXTERNAL_DOWNLOAD=y
BR2_TOOLCHAIN_EXTERNAL_URL="https://github.com/nerves-project/toolchains/releases/download/v1.5.0/nerves_toolchain_mipsel_nerves_linux_musl-linux_x86_64-1.5.0-139CB15.tar.xz"

# BR2_TOOLCHAIN_EXTERNAL_INET_RPC is not set


BR2_LINUX_KERNEL=y
BR2_LINUX_KERNEL_CUSTOM_VERSION=y
BR2_LINUX_KERNEL_CUSTOM_VERSION_VALUE="5.4.154"
BR2_LINUX_KERNEL_PATCH="${NERVES_DEFCONFIG_DIR}/board/hi-link/hlk-7628n/patches"
BR2_LINUX_KERNEL_USE_CUSTOM_CONFIG=y
BR2_LINUX_KERNEL_CUSTOM_CONFIG_FILE="${NERVES_DEFCONFIG_DIR}/board/hi-link/hlk-7628n/ram_root_layout/linux-5.4.defconfig"
BR2_LINUX_KERNEL_VMLINUX_BIN=y
BR2_LINUX_KERNEL_XZ=y
BR2_LINUX_KERNEL_DTS_SUPPORT=y
BR2_LINUX_KERNEL_CUSTOM_DTS_PATH="${NERVES_DEFCONFIG_DIR}/board/hi-link/hlk-7628n/mt7628an.dtsi ${NERVES_DEFCONFIG_DIR}/board/hi-link/hlk-7628n/ram_root_layout/mt7628an_hilink_hlk-7628n.dts"


BR2_ROOTFS_SKELETON_CUSTOM=y
BR2_ROOTFS_SKELETON_CUSTOM_PATH="${BR2_EXTERNAL_NERVES_PATH}/board/nerves-common/skeleton"
BR2_INIT_NONE=y
BR2_ROOTFS_DEVICE_TABLE="${BR2_EXTERNAL_NERVES_PATH}/board/nerves-common/device_table.txt"
BR2_ENABLE_LOCALE_WHITELIST="locale-archive"
BR2_GENERATE_LOCALE="en_US.UTF-8"
BR2_ROOTFS_OVERLAY="${BR2_EXTERNAL_NERVES_PATH}/board/nerves-common/rootfs_overlay ${NERVES_DEFCONFIG_DIR}/rootfs_overlay"
BR2_ROOTFS_POST_BUILD_SCRIPT="${NERVES_DEFCONFIG_DIR}/post-build.sh ${BR2_EXTERNAL_NERVES_PATH}/board/nerves-common/post-build.sh"
BR2_ROOTFS_POST_IMAGE_SCRIPT="${NERVES_DEFCONFIG_DIR}/post-createfs.sh ${NERVES_DEFCONFIG_DIR}/board/hi-link/hlk-7628n/ram_root_layout/post-image.sh"
BR2_PACKAGE_BUSYBOX_CONFIG="${BR2_EXTERNAL_NERVES_PATH}/board/nerves-common/busybox.config"

BR2_PACKAGE_FWUP=y
BR2_PACKAGE_MTD=y
BR2_PACKAGE_UBOOT_TOOLS=y
BR2_PACKAGE_IW=y
BR2_PACKAGE_MTD_MKFSJFFS2=y

BR2_PACKAGE_PIGPIO=y
BR2_PACKAGE_LIBP11=y
BR2_PACKAGE_UNIXODBC=y
BR2_PACKAGE_LIBMNL=y
BR2_PACKAGE_WIRELESS_REGDB=y
BR2_PACKAGE_WPA_SUPPLICANT=y
BR2_PACKAGE_WPA_SUPPLICANT_AP_SUPPORT=y
BR2_PACKAGE_WPA_SUPPLICANT_MESH_NETWORKING=y
BR2_PACKAGE_WPA_SUPPLICANT_AUTOSCAN=y
BR2_PACKAGE_WPA_SUPPLICANT_HOTSPOT=y
BR2_PACKAGE_WPA_SUPPLICANT_DEBUG_SYSLOG=y
BR2_PACKAGE_WPA_SUPPLICANT_WPS=y
BR2_PACKAGE_WPA_SUPPLICANT_WPA3=y
BR2_PACKAGE_WPA_SUPPLICANT_CTRL_IFACE=y
# BR2_TARGET_ROOTFS_TAR is not set
BR2_NERVES_SYSTEM_NAME="nerves_system_hlk7628n"
BR2_NERVES_ADDITIONAL_IMAGE_FILES="${NERVES_DEFCONFIG_DIR}/fwup.conf"
BR2_PACKAGE_NBTTY=y
BR2_PACKAGE_NERVES_CONFIG=y


BR2_TARGET_ROOTFS_SQUASHFS=y
BR2_TARGET_ROOTFS_SQUASHFS4_XZ=y
BR2_PACKAGE_HOST_FWUP=y
BR2_PACKAGE_HOST_MTD=y
BR2_PACKAGE_HOST_UBOOT_TOOLS=y

BR2_PACKAGE_HOST_LZMA_OLD=y

BR2_LINUX_KERNEL_EXT_OPENWRT_PATCHES=y
BR2_LINUX_KERNEL_EXT_OPENWRT_PATCHES_RAMIPS=y

BR2_PACKAGE_BUSYBOX_CONFIG_FRAGMENT_FILES="${NERVES_DEFCONFIG_DIR}/board/hi-link/hlk-7628n/busybox.config"

BR2_PACKAGE_SWCONFIG=y
BR2_PACKAGE_MT76_MT76X8=y
```

## package/lzma-old/Config.in
```kconfig
config BR2_PACKAGE_HOST_LZMA_OLD
    bool "LZMA Utils 4.x (host)"
	help
	  Old LZMA Utils (host)
```

## package/mac80211_nodrv/Config.in
```kconfig
config BR2_PACKAGE_MAC80211_NODRV
    bool "802.11 wireless driver, without actual device driver"
	help
    	Linux 802.11 Wireless Networking Stack, without actual vendor drivers
```

## package/mt76-mt76x8/Config.in
```kconfig
config BR2_PACKAGE_MT76_MT76X8
    bool "MediaTek MT76x8 wireless driver"
    select BR2_PACKAGE_MAC80211_NODRV
	help
	  MediaTek MT76x8 wireless driver, from OpenWrt mt76 repo.
```

## package/swconfig/Config.in
```kconfig
config BR2_PACKAGE_SWCONFIG
	bool "swconfig from OpenWrt"
	select BR2_PACKAGE_LIBNL
	select BR2_PACKAGE_LIBUBOX
	help
		OpenWrt swconfig binary, remove uci dependency
```

## package/wpad-openssl/Config.in
```kconfig
config BR2_PACKAGE_WPAD_OPENSSL
	bool "IEEE 802.1x Auth/Supplicant"
	select BR2_PACKAGE_LIBNL
	select BR2_PACKAGE_MAC80211_NODRV
	select BR2_PACKAGE_OPENSSL
	select BR2_PACKAGE_LIBUBOX
	help
		wpad full with openssl support ported from OpenWrt.
		This package contains a full featured IEEE 802.1x/WPA/EAP/RADIUS
		 Authenticator and Supplicant
```
